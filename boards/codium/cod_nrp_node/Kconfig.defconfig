## boards/codium/cod_nrp_node/Kconfig.defconfig
```kconfig
# Copyright (c) 2026 Codium Electronique
# SPDX-License-Identifier: Apache-2.0

config HW_STACK_PROTECTION
	default ARCH_HAS_STACK_PROTECTION

if BOARD_COD_NRP_NODE_NRF9151 || BOARD_COD_NRP_NODE_NRF9151_NS

config BOARD_COD_NRP_NODE
	select USE_DT_CODE_PARTITION if BOARD_COD_NRP_NODE_NRF9151_NS

config BT_HCI_VS
	default y if BT

config BT_WAIT_NOP
	default BT && $(dt_nodelabel_enabled,nrf54l15_reset)

endif # BOARD_COD_NRP_NODE_NRF9151 || BOARD_COD_NRP_NODE_NRF9151_NS

if BOARD_COD_NRP_NODE_NRF54L15_CPUAPP_NS

config BOARD_COD_NRP_NODE
	select USE_DT_CODE_PARTITION if BOARD_COD_NRP_NODE_NRF54L15_CPUAPP_NS

config HAS_BT_CTLR
	default BT

config BT_WAIT_NOP
	default BT && $(dt_nodelabel_enabled,nrf54l15_reset)

# By default, if we build for a Non-Secure version of the board,
# enable building with TF-M as the Secure Execution Environment.
config BUILD_WITH_TFM
	default y

endif # BOARD_COD_NRP_NODE_NRF54L15_CPUAPP_NS
```

## boards/codium/cod_nrp_node/board.yml
```yaml
# Copyright (c) 2026 Codium Electronique
# SPDX-License-Identifier: Apache-2.0

board:
  name: cod_nrp_node
  full_name: Codium NR+ node
  vendor: codium
  socs:
  - name: nrf9151
    variants:
    - name: 'ns'
  - name: nrf54l15
    variants:
      - name: 'ns'
        cpucluster: cpuapp
  revision:
    format: major.minor.patch
    default: "1.0.0"
    revisions:
    - name: "1.0.0"
runners:
  run_once:
    '--recover':
      - runners:
          - nrfjprog
          - nrfutil
        run: first
        groups:
          - boards:
              - cod_nrp_node/nrf9151
              - cod_nrp_node/nrf9151/ns
              - cod_nrp_node/nrf54l15/cpuapp
              - cod_nrp_node/nrf54l15/cpuapp/ns
    '--erase':
      - runners:
          - nrfjprog
          - jlink
          - nrfutil
        run: first
        groups:
          - boards:
              - cod_nrp_node/nrf9151
              - cod_nrp_node/nrf9151/ns
              - cod_nrp_node/nrf54l15/cpuapp
              - cod_nrp_node/nrf54l15/cpuapp/ns
    '--reset':
      - runners:
          - nrfjprog
          - jlink
          - nrfutil
        run: last
        groups:
          - boards:
              - cod_nrp_node/nrf9151
              - cod_nrp_node/nrf9151/ns
              - cod_nrp_node/nrf54l15/cpuapp
              - cod_nrp_node/nrf54l15/cpuapp/ns
```

## boards/codium/cod_nrp_node/cod_nrp_node_nrf9151_ns_defconfig
```kconfig
# Copyright (c) 2026 Codium Electronique
# SPDX-License-Identifier: Apache-2.0

# Enable MPU
CONFIG_ARM_MPU=y

# Enable TrustZone-M
CONFIG_ARM_TRUSTZONE_M=y

# This board implies building Non-Secure firmware
CONFIG_TRUSTED_EXECUTION_NONSECURE=y

# Enable GPIO
CONFIG_GPIO=y

# Enable UART driver
CONFIG_SERIAL=y

# FIXME: re-enable once the HCI UART support is there
#CONFIG_UART_ASYNC_API=y
#CONFIG_UART_INTERRUPT_DRIVEN=y
#CONFIG_UART_1_ASYNC=y
#CONFIG_UART_1_INTERRUPT_DRIVEN=n
#CONFIG_NRF_SW_LPUART=y
#CONFIG_NRF_SW_LPUART_INT_DRIVEN=y

# Enable console
CONFIG_CONSOLE=y
CONFIG_UART_CONSOLE=y

# TF-M UART config
CONFIG_TFM_SECURE_UART1=n
CONFIG_TFM_SECURE_UART0=y
CONFIG_TFM_SECURE_UART_SHARE_INSTANCE=y

# Enable SPI
CONFIG_SPI=y

# SPI flash
CONFIG_FLASH=y
CONFIG_STREAM_FLASH=y
CONFIG_FLASH_MAP=y
CONFIG_FLASH_PAGE_LAYOUT=y
CONFIG_STREAM_FLASH_ERASE=y
CONFIG_MPU_ALLOW_FLASH_WRITE=y

CONFIG_SPI_NOR=y
CONFIG_SPI_NOR_SFDP_RUNTIME=y
CONFIG_SPI_NOR_FLASH_LAYOUT_PAGE_SIZE=4096
CONFIG_SPI_NOR_ACTIVE_DWELL_MS=10
```
